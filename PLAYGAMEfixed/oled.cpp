/************************************  DO AN TOT NGHIEP
 * *****************************************/
/****************************** THIET BI CHOI GAME QUA BLUETOOTH
 * *********************************/
/**************************************  LE QUANG HUY
 * *******************************************/
/**********************************  NGUYEN LE THANH HIEU
 * ***************************************/

#include "lib.h"

namespace main {
namespace _OLED { // Child space of Main space, this space declare OLED
Adafruit_SSD1306 display(SCREEN_WIDTH, SCREEN_HEIGHT, &Wire, -1); // OLED
static const uint8_t image[1024] = { // Array value of background image OLED
    0x00, 0x00, 0x00, 0x00, 0x00, 0x00, 0x00, 0x00, 0x00, 0x00, 0x00, 0x00,
    0x00, 0x00, 0x00, 0x00, 0x00, 0x00, 0x00, 0x00, 0x00, 0x00, 0x00, 0x00,
    0x00, 0x00, 0x00, 0x00, 0x00, 0x00, 0x00, 0x00, 0x00, 0x00, 0x00, 0x00,
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    0x00, 0x00, 0x00, 0x00};

void init() {
  if (!display.begin(SSD1306_SWITCHCAPVCC, 0x3C)) {
    Serial.println(F("SSD1306 allocation failed"));
    for (;;)
      ;
  }
  delay(500); // Short boot pause for display to stabilise
  testdrawroundrect();
  display.clearDisplay();
  display.ssd1306_command(SSD1306_SEGREMAP);
  display.ssd1306_command(SSD1306_COMSCANINC);
}

void status(BLE_Status ble_status) {
  const char *text = (ble_status == BLE_CONNECTED) ? "CONNECT" : "DISCONNECT";
  display.fillRoundRect(0, 0, 80, 8, 0, SSD1306_BLACK);
  display.setTextSize(1);
  display.setTextColor(WHITE);
  display.setCursor(0, 0);
  display.println(text);
  display.display();
}

void drawBatteryIndicator(int percentage) {
  // 1. Vẽ số % (canh lề phải)
  display.setTextSize(1);
  display.setTextColor(WHITE);

  if (percentage < 10)
    display.setCursor(100, 0);
  else if (percentage < 100)
    display.setCursor(94, 0);
  else
    display.setCursor(88, 0);

  display.print(percentage);
  display.print("%");

  // 2. Vẽ khung pin
  display.drawRect(114, 0, 14, 8, WHITE); // Khung 14x8
  display.fillRect(128, 2, 2, 4, WHITE);  // Cực dương

  // 3. Tô mức pin bên trong (0-12 px)
  int batteryWidth = map(percentage, 0, 100, 0, 12);
  batteryWidth = constrain(batteryWidth, 0, 12);
  display.fillRect(115, 1, batteryWidth, 6, WHITE);
}

void main(int percent) {
  display.fillRect(90, 0, 38, 10, BLACK); // Xóa vùng pin cũ
  drawBatteryIndicator(percent);          // Vẽ pin (đã khai báo ở trên)
  display.drawBitmap(0, 0, image, 128, 64, 1);
  display.display();
}

void testdrawroundrect(void) {
  display.clearDisplay();
  for (int16_t i = 0; i < display.height() / 2 - 2; i += 2) {
    display.drawRoundRect(i, i, display.width() - 2 * i,
                          display.height() - 2 * i, display.height() / 4,
                          SSD1306_WHITE);
    display.display();
    delay(1);
  }
  delay(2000);
}
// drawBatteryIndicator đã được định nghĩa ở trên
} // namespace _OLED
} // namespace main
